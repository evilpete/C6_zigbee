## sdkconfig.defaults
```kconfig
CONFIG_IEEE802154_ENABLED=y
CONFIG_IEEE802154_RX_BUFFER_SIZE=20
CONFIG_IEEE802154_FRAME_QUEUE_LENGTH=20
CONFIG_ZB_ENABLED=n
CONFIG_OPENTHREAD_ENABLED=n
CONFIG_NVS_FLASH_MAX_PAGES=4
CONFIG_ESP_CONSOLE_USB_SERIAL_JTAG=y
CONFIG_ARDUINO_USB_CDC_ON_BOOT=y
```
